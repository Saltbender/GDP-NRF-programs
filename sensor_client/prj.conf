## CMakeLists.txt
```
# SPDX-License-Identifier: Apache-2.0

cmake_minimum_required(VERSION 3.20.0)
find_package(Zephyr REQUIRED HINTS $ENV{ZEPHYR_BASE})

project("am2320 coap client")
FILE(GLOB app_sources src/*.c)
target_sources(app PRIVATE ${app_sources})
```

## Kconfig
```
#
# Copyright (c) 2020 Nordic Semiconductor ASA
#
# SPDX-License-Identifier: LicenseRef-Nordic-5-Clause
#

menu "Zephyr Kernel"
source "Kconfig.zephyr"
endmenu

module = COAP_CLIENT
module-str = CoAP client
source "${ZEPHYR_BASE}/subsys/logging/Kconfig.template.log_config"

module = COAP_CLIENT_UTILS
module-str = CoAP client utilities
source "${ZEPHYR_BASE}/subsys/logging/Kconfig.template.log_config"

module = BLE_UTILS
module-str = Bluetooth connection utilities
source "${ZEPHYR_BASE}/subsys/logging/Kconfig.template.log_config"
```

## sample.yaml
```
sample:
  description: Test CoAP communication in Thread network
  name: OpenThreadThread CoAP Client
tests:
  sample.openthread.coap_client:
    build_only: true
    integration_platforms:
      - nrf5340dk_nrf5340_cpuapp
      - nrf5340dk_nrf5340_cpuapp_ns
      - nrf52840dk_nrf52840
      - nrf52833dk_nrf52833
      - nrf21540dk_nrf52840
    platform_allow: nrf5340dk_nrf5340_cpuapp nrf5340dk_nrf5340_cpuapp_ns nrf52840dk_nrf52840
      nrf52833dk_nrf52833 nrf21540dk_nrf52840
    tags: ci_build
  sample.openthread.coap_client.mtd.multiprotocol_ble:
    build_only: true
    extra_args: OVERLAY_CONFIG=overlay-mtd.conf;overlay-multiprotocol_ble.conf
    integration_platforms:
      - nrf5340dk_nrf5340_cpuapp
      - nrf5340dk_nrf5340_cpuapp_ns
      - nrf52840dk_nrf52840
      - nrf21540dk_nrf52840
    platform_allow: nrf5340dk_nrf5340_cpuapp nrf5340dk_nrf5340_cpuapp_ns nrf52840dk_nrf52840
      nrf52833dk_nrf52833 nrf21540dk_nrf52840
    tags: ci_build
```

## prj.conf
```kconfig
#
# Copyright (c) 2020 Nordic Semiconductor
#
# SPDX-License-Identifier: LicenseRef-Nordic-5-Clause
#

# nRF board library
CONFIG_DK_LIBRARY=y

# Enable CoAP utils and CoAP protocol
CONFIG_COAP_UTILS=y

# Configure sample logging setting
CONFIG_LOG=y
CONFIG_COAP_CLIENT_LOG_LEVEL_DBG=y
CONFIG_COAP_CLIENT_UTILS_LOG_LEVEL_DBG=y
CONFIG_COAP_UTILS_LOG_LEVEL_DBG=y
CONFIG_OPENTHREAD_LOG_LEVEL_NOTE=y
CONFIG_OPENTHREAD_DEBUG=y

# Adjust log strdup settings

# Generic networking options
CONFIG_NETWORKING=y

# L2 OpenThread enabling
CONFIG_NET_L2_OPENTHREAD=y

# Network shell
CONFIG_SHELL=y
CONFIG_OPENTHREAD_SHELL=y
CONFIG_SHELL_ARGC_MAX=26
CONFIG_SHELL_CMD_BUFF_SIZE=416

# Network sockets
CONFIG_NET_SOCKETS=y
CONFIG_NET_SOCKETS_POSIX_NAMES=y
CONFIG_NET_SOCKETS_POLL_MAX=4

# Same network Master Key for client and server
CONFIG_OPENTHREAD_NETWORKKEY="00:11:22:33:44:55:66:77:88:99:aa:bb:cc:dd:ee:ff"

CONFIG_ASSERT=y
CONFIG_ASSERT_NO_COND_INFO=y
CONFIG_MBEDTLS_SHA1_C=n
CONFIG_FPU=y

#Other OpenThread settings

CONFIG_OPENTHREAD_DNS_CLIENT=y
CONFIG_OPENTHREAD_SLAAC=y
CONFIG_NET_IF_UNICAST_IPV6_ADDR_COUNT=6

#Memory stack settings
CONFIG_COUNTER=y
CONFIG_COUNTER_RTC2=y
CONFIG_ISR_STACK_SIZE=2048
CONFIG_MAIN_STACK_SIZE=2560
CONFIG_SYSTEM_WORKQUEUE_STACK_SIZE= 2560

CONFIG_CBPRINTF_LIBC_SUBSTS=y

#Thread/stack debug settings
CONFIG_THREAD_ANALYZER=y
CONFIG_THREAD_ANALYZER_AUTO=n
CONFIG_THREAD_ANALYZER_ISR_STACK_USAGE=y
CONFIG_THREAD_ANALYZER_USE_LOG=y
CONFIG_THREAD_NAME=n
```

## overlay-mtd.conf
```kconfig
#
# Copyright (c) 2020 Nordic Semiconductor
#
# SPDX-License-Identifier: LicenseRef-Nordic-5-Clause
#

# Enable MTD Sleepy End Device
CONFIG_OPENTHREAD_MTD=y
CONFIG_OPENTHREAD_MTD_SED=y
CONFIG_OPENTHREAD_POLL_PERIOD=3000
CONFIG_RAM_POWER_DOWN_LIBRARY=y
CONFIG_PM_DEVICE=y

# This variant requires increased system workqueue stack size
CONFIG_SYSTEM_WORKQUEUE_STACK_SIZE=2048
```

## sensor.conf
```kconfig
CONFIG_STDOUT_CONSOLE=y
CONFIG_I2C=y
CONFIG_SENSOR=y

CONFIG_LOG_MODE_DEFERRED=y


#USB fuckery configs
CONFIG_UART_LINE_CTRL=y
#CONFIG_SHELL_BACKEND_SERIAL_CHECK_DTR=y
CONFIG_USB_CDC_ACM_LOG_LEVEL_OFF=y

CONFIG_USB_DEVICE_STACK=y
CONFIG_USB_DEVICE_REMOTE_WAKEUP=n
CONFIG_USB_CDC_ACM=y

CONFIG_USB_DEVICE_MANUFACTURER="Nordic Semiconductor ASA"
CONFIG_USB_DEVICE_PRODUCT="AM2320 CLI"
CONFIG_USB_DEVICE_VID=0x1915
CONFIG_USB_DEVICE_PID=0x0000
```

## app.overlay
```dts
/*
 * Copyright (c) 2019 Infineon Technologies AG
 *
 * SPDX-License-Identifier: Apache-2.0
 */

 / {
	chosen {
		zephyr,shell-uart = &cdc_acm_uart0;
		zephyr,entropy = &rng;
	};
};

&zephyr_udc0 {
	cdc_acm_uart0: cdc_acm_uart0 {
		compatible = "zephyr,cdc-acm-uart";
	};
};
```

## src/am2320.c
```c
/*
 * Copyright (c) 2019 Infineon Technologies AG
 *
 * SPDX-License-Identifier: Apache-2.0
 */

#include <zephyr/zephyr.h>
#include <zephyr/device.h>
#include <zephyr/drivers/sensor.h>
#include <stdlib.h>
#include <zephyr/logging/log.h>

#include <zephyr/drivers/i2c.h>

#define SENSOR_ADDRESS 0x5C

LOG_MODULE_DECLARE(coap_client_utils, CONFIG_COAP_CLIENT_UTILS_LOG_LEVEL);


/* Series of commands that need to be provided to the sensor
* Meaning of values:
	0x03: function code for sensor
	0x00: starting address of register to be read from
	0x04: read 4 registers from the sensor
*/
static uint8_t humidity_temp_send_buffer[3] = {0x03, 0x00, 0x04};
// char* humidity_useless,char* temperature_useless)
//Receive buffer needs to be length 7
int getSensorValues(const struct device* dev, uint16_t* humidity,uint16_t* temperature){
	uint8_t empty_buffer = 0;
	uint8_t wake_byte_count = 0;
	uint8_t error;

	// uint16_t humidity;
	// uint16_t temperature;

	uint8_t receive_buffer[8];

	//Wake up the device
	error = i2c_write(dev, &empty_buffer, wake_byte_count, SENSOR_ADDRESS);

	// k_sleep(K_MSEC(1));
	//k_busy_wait(1000);
	error = i2c_write(dev, humidity_temp_send_buffer, sizeof(humidity_temp_send_buffer)/sizeof(uint8_t), SENSOR_ADDRESS);

	//k_busy_wait(1000);
	error = i2c_read(dev, receive_buffer, sizeof(receive_buffer)/sizeof(uint8_t), SENSOR_ADDRESS);

	/*Humidity and temperature is receive as 2 bytes, first one for higher byte and second one for lower byte
	Humidity is received first, then temperature
	Full list of bytes received:
	0: Function code
	1: Number of bytes to read
	2,3: Humidity
	4,5: Temperature
	6,7: CRC checksum
	*/

    LOG_INF("RECEIVED DATA!");
	*humidity = receive_buffer[2] << 8 | receive_buffer[3];
	*temperature = receive_buffer[4] << 8 | receive_buffer[5];

	return 0;
}

int initI2C (struct device* dev){
	if (!i2c_configure(dev, I2C_SPEED_STANDARD)){
		printk("Error configuring the I2C device");
		return -1;
	}

	if (!device_is_ready(dev)) {
		printk("Device %s is not ready\n", dev->name);
		return -1;
	}
	LOG_INF("dev %p name %s\n", dev, dev->name);
	return 0;
}

// void main(void)
// {
// 	/*Initialise USB for printing*/
// 	/*USB fuckery starts here*/
// 	const struct device *usb_dev = DEVICE_DT_GET(DT_CHOSEN(zephyr_shell_uart));

// 	if (usb_enable(NULL)) {
// 		return;
// 	}
	
// 	/*USB fuckery complete
// 	Now entering main application*/

// 	printk("Hello Am2320\n");
// 	const struct device *i2c_dev = DEVICE_DT_GET(DT_NODELABEL(i2c0));
// 	if (!i2c_configure(i2c_dev, I2C_SPEED_STANDARD)){
// 		printk("Error configuring the I2C device");
// 	}

// 	if (!device_is_ready(i2c_dev)) {
// 		printk("Device %s is not ready\n", i2c_dev->name);
// 		return;
// 	}

// 	printk("dev %p name %s\n", i2c_dev, i2c_dev->name);

// 	uint16_t humidity, temperature;

// 	while (1) {
// 		getSensorValues(i2c_dev, &humidity, &temperature);
// 		//printk("temp: %d.%06d; humidity: %d.%06d\n",
// 		     // temp.val1, abs(temp.val2), press.val1, press.val2);
// 		printk("temp: %d; humidity: %d \%\n",
// 		      temperature, humidity);
// 		k_sleep(K_MSEC(1000));
// 	}
// }
```

## src/am2320.h
```c
#ifndef _AM2320_H__
#define _AM2320_H__

/** @brief Function to initialise an i2c device. 
 * 
*/

int initI2C (struct device* dev);

/** @brief Function to retrieve data from the AM2320 sensor, requires an initialiased i2c device as argument 
 * 
*/

int getSensorValues(const struct device* dev, uint16_t* humidity,uint16_t* temperature);

#endif 
```

## src/coap_client.c
```c
/*
 * Copyright (c) 2020 Nordic Semiconductor ASA
 *
 * SPDX-License-Identifier: LicenseRef-Nordic-5-Clause
 */

#include <zephyr/kernel.h>
#include <dk_buttons_and_leds.h>
#include <zephyr/logging/log.h>
#include <ram_pwrdn.h>
#include <zephyr/device.h>
#include <zephyr/pm/device.h>



#include <zephyr/drivers/counter.h>
#include <zephyr/drivers/i2c.h>

#include <zephyr/usb/usb_device.h>

#include "coap_client_utils.h"
#include "am2320.h"

LOG_MODULE_DECLARE(coap_client_utils, CONFIG_COAP_CLIENT_UTILS_LOG_LEVEL);

#define OT_CONNECTION_LED DK_LED1
#define COUNTER_LED DK_LED2
#define MTD_SED_LED DK_LED3

#define ALARM_DELAY 1000000 /*1 second, units for function is usec*/
#define ALARM_CHANNEL 0

/*Variables for storing sensor data*/
static const struct device* i2c_dev = DEVICE_DT_GET(DT_NODELABEL(i2c0));
static uint16_t temperature = 100;
static uint16_t humidity = 100;

/*Variable for work struct*/
struct k_work fetch_sensor_work;

static bool isLedOn = 0;

static void on_ot_connect(struct k_work *item)
{
	ARG_UNUSED(item);
	coap_client_send_provisioning_request();
	dk_set_led_on(OT_CONNECTION_LED);
}

static void on_ot_disconnect(struct k_work *item)
{
	ARG_UNUSED(item);

	dk_set_led_off(OT_CONNECTION_LED);
}

static void on_mtd_mode_toggle(uint32_t med)
{
#if IS_ENABLED(CONFIG_PM_DEVICE)
	const struct device *cons = DEVICE_DT_GET(DT_CHOSEN(zephyr_console));

	if (!device_is_ready(cons)) {
		return;
	}

	if (med) {
		pm_device_action_run(cons, PM_DEVICE_ACTION_RESUME);
	} else {
		pm_device_action_run(cons, PM_DEVICE_ACTION_SUSPEND);
	}
#endif
	dk_set_led(MTD_SED_LED, med);
}

/*Function provided to k_work object, retrieves sensors value*/
static void fetch_sensor_data(struct k_work *item){
	ARG_UNUSED(item);
	getSensorValues(i2c_dev, &humidity, &temperature);
}


/*Callback provided to counter top config*/
static void submit_read_sensor_work (const struct device *dev, void *user_data){
	ARG_UNUSED(dev);
	ARG_UNUSED(user_data);
	LOG_INF("countering every second!\n");
	dk_set_led(COUNTER_LED, !isLedOn); 
	isLedOn = !isLedOn;

	k_work_submit(&fetch_sensor_work);

	if (isProvisioned()){
		coap_client_send_sensor_data(temperature, humidity);
	}
}

void main(void)
{
	int ret;
	// uint16_t humidity = 100;
	// uint16_t temperature = 100;

	LOG_INF("Start CoAP-client sample");
	printk("Start CoAP-client sample");

	if (usb_enable(NULL)) {
		return;
	}

	if (IS_ENABLED(CONFIG_RAM_POWER_DOWN_LIBRARY)) {
		power_down_unused_ram();
	}

	ret = dk_leds_init();
	if (ret) {
		LOG_ERR("Cannot init leds, (error: %d)", ret);
		return;
	}

	/*Initialise k_work related stuff*/
	k_work_init(&fetch_sensor_work, fetch_sensor_data);

	/*Initialise I2C peripheral for communicating with the sensor*/
	ret = initI2C(i2c_dev);
	if (ret){
		LOG_ERR("I2C initialisation error code: %d", ret);
	}
	LOG_INF("dev %p name %s\n", i2c_dev, i2c_dev->name);
	/*Initialise RTC counter device, provide top value and callback function*/

	const struct device* rtc_dev = DEVICE_DT_GET(DT_NODELABEL(rtc2));
	counter_stop(rtc_dev);
	struct counter_top_cfg counter_cfg;
	counter_cfg.ticks = counter_us_to_ticks(rtc_dev, 5*ALARM_DELAY);
	counter_cfg.callback = submit_read_sensor_work;
	counter_cfg.user_data = &counter_cfg;
	ret = counter_set_top_value(rtc_dev, &counter_cfg);


	if (-EINVAL == ret) {
		printk("Alarm settings invalid\n");
	} else if (-ENOTSUP == ret) {
		printk("Alarm setting request not supported\n");
	} else if (ret != 0) {
		printk("Error\n");
	}


	coap_client_utils_init(on_ot_connect, on_ot_disconnect,
			       on_mtd_mode_toggle);

	while (!isProvisioned()){
		coap_client_send_provisioning_request();
		printk("waiting for provisioning");
		k_sleep(K_SECONDS(10));
	}
	counter_start(rtc_dev);


	// while (1){
	// 	LOG_INF("countering every second!\n");

	// 	dk_set_led(COUNTER_LED, !isLedOn); 
	// 	isLedOn = !isLedOn;

	// 	getSensorValues(i2c_dev, &humidity, &temperature);

	// 	if (isProvisioned()){
	// 		coap_client_send_sensor_data(temperature, humidity);
	// 	}

	// 	k_msleep(5000);
	// }
}
```

## src/coap_client_utils.c
```c
/*
 * Copyright (c) 2020 Nordic Semiconductor ASA
 *
 * SPDX-License-Identifier: LicenseRef-Nordic-5-Clause
 */

#include <zephyr/kernel.h>

#include <net/coap_utils.h>
#include <zephyr/logging/log.h>
#include <zephyr/net/openthread.h>
#include <zephyr/net/socket.h>
#include <openthread/thread.h>

#include <zephyr/debug/thread_analyzer.h>

#include <stdio.h>

#include "coap_server_client_interface.h"
#include "coap_client_utils.h"

LOG_MODULE_REGISTER(coap_client_utils, CONFIG_COAP_CLIENT_UTILS_LOG_LEVEL);

#define RESPONSE_POLL_PERIOD 100

static uint32_t poll_period;

static bool is_connected;

// static struct k_work send_sensor_data_work;
static struct k_work toggle_MTD_SED_work;
static struct k_work on_connect_work;
static struct k_work on_disconnect_work;

//Testing for implementing k_work object as a member of a parent struct
//Ease passing of data to the function
//Contains k_work object inside as well

static struct work_var_container provisioning_container;
static struct work_sensor_container sensor_data_container;

mtd_mode_toggle_cb_t on_mtd_mode_toggle;

/* Options supported by the server */
static const char *const node_option[] = { NODE1_URI_PATH, NULL };
static const char *const provisioning_option[] = { PROVISIONING_URI_PATH, NULL };

/* Thread multicast mesh local address */
static struct sockaddr_in6 multicast_local_addr = {
	.sin6_family = AF_INET6,
	.sin6_port = htons(COAP_PORT),
	.sin6_addr.s6_addr = { 0xff, 0x03, 0x00, 0x00, 0x00, 0x00, 0x00, 0x00,
			       0x00, 0x00, 0x00, 0x00, 0x00, 0x00, 0x00, 0x01 },
	.sin6_scope_id = 0U
};

/* Variable for storing server address acquiring in provisioning handshake */
static char unique_local_addr_str[INET6_ADDRSTRLEN] = {0};
static struct sockaddr_in6 unique_local_addr = {
	.sin6_family = AF_INET6,
	.sin6_port = htons(COAP_PORT),
	.sin6_addr.s6_addr = {0, },
	.sin6_scope_id = 0U
};

static bool is_mtd_in_med_mode(otInstance *instance)
{
	return otThreadGetLinkMode(instance).mRxOnWhenIdle;
}

static void poll_period_response_set(void)
{
	otError error;

	otInstance *instance = openthread_get_default_instance();

	if (is_mtd_in_med_mode(instance)) {
		return;
	}

	if (!poll_period) {
		poll_period = otLinkGetPollPeriod(instance);

		error = otLinkSetPollPeriod(instance, RESPONSE_POLL_PERIOD);
		__ASSERT(error == OT_ERROR_NONE, "Failed to set pool period");

		LOG_INF("Poll Period: %dms set", RESPONSE_POLL_PERIOD);
	}
}

static void poll_period_restore(void)
{
	otError error;
	otInstance *instance = openthread_get_default_instance();

	if (is_mtd_in_med_mode(instance)) {
		return;
	}

	if (poll_period) {
		error = otLinkSetPollPeriod(instance, poll_period);
		__ASSERT_NO_MSG(error == OT_ERROR_NONE);

		LOG_INF("Poll Period: %dms restored", poll_period);
		poll_period = 0;
	}
}

static int on_provisioning_reply(const struct coap_packet *response,
				 struct coap_reply *reply,
				 const struct sockaddr *from)
{
	int ret = 0;
	const uint8_t *payload;
	uint16_t payload_size = 0u;
	
	//Testing for printing out IPaddr from OT
	// otInstance *instance = openthread_get_default_instance();
	// void * ipaddr_ot = otThreadGetMeshLocalEid(instance);
	// int ipaddr_size = sizeof(otIp6Address);
	// LOG_HEXDUMP_INF(ipaddr_ot, ipaddr_size, "IP address");

	ARG_UNUSED(reply);
	ARG_UNUSED(from);

	payload = coap_packet_get_payload(response, &payload_size);

	if (payload == NULL) {
		LOG_ERR("No data received");
		ret = -EINVAL;
		goto exit;
	}
	
	// LOG_INF("Payload received: %s", payload);
	// LOG_INF("Payload size: %d", payload_size);

	//Convert the payload from ASCII encoded characters into literal integers
	//Process is performed in 2 byte char fragments turning into 1 byte uint8:

	// if (payload_size != 32) {
	// 	LOG_ERR("Questionable data format received");
	// 	ret = -EINVAL;
	// 	goto exit;
	// }

	// uint8_t ipaddr_int [16];
	// for(int i = 0; i < (payload_size/2); i++){
	// 	char* unused_ptr;
	// 	char payload_fragment [2];

	// 	memcpy(&payload_fragment, payload+(2*i), 2);
	// 	ipaddr_int[i] = strtol(payload_fragment, &unused_ptr, 16);
	// }

	// LOG_HEXDUMP_INF(ipaddr_int, 16, "Fully converted IP fragment");
	if (!inet_pton(AF_INET6, payload, &unique_local_addr.sin6_addr)){
		LOG_ERR("Received data is not IPv6 address: %d", errno);
		ret = -errno;
		goto exit;
	}
	memcpy(unique_local_addr_str, payload, payload_size);

	LOG_INF("Received peer address: %s", unique_local_addr_str);

exit:
	if (IS_ENABLED(CONFIG_OPENTHREAD_MTD_SED)) {
		poll_period_restore();
	}

	return ret;
}

static void send_sensor_data(struct k_work *item)
{
	ARG_UNUSED(item);

	char payload [20];
	char sprint_buffer [20];
	const char slash[] = "/";

	/* Convert temperature into payload, then concat slash,
	then convert temperature to payload and concat that*/
	snprintfcb(payload,10, "%.1f", sensor_data_container.temperature);
	LOG_INF("Payload after sprintf: %s", payload);
	snprintfcb(sprint_buffer,10 , "%.0f", sensor_data_container.humidity);
	
	strcat(payload, slash);
	strcat(payload, sprint_buffer);

	if (unique_local_addr.sin6_addr.s6_addr16[0] == 0) {
		LOG_WRN("Peer address not set. Activate 'provisioning' option "
			"on the server side");
		return;
	}

	LOG_INF("Sending sensor data to: %s", unique_local_addr_str);
	LOG_INF("Payload sent: %s", payload);
	//thread_analyzer_print();
	coap_send_request(COAP_METHOD_PUT,
			  (const struct sockaddr *)&unique_local_addr,
			  node_option, payload, strlen(payload), NULL);
}

static void send_provisioning_request(struct k_work *item)
{
	if (IS_ENABLED(CONFIG_OPENTHREAD_MTD_SED)) {
		/* decrease the polling period for higher responsiveness */
		poll_period_response_set();
	}
	//LOG_INF("Testing data before CONTAINER_OF method: %s", provisioning_container.testing_data);

	//Testing for container of functionality
	// struct work_var_container * container_ptr = CONTAINER_OF(item, struct work_var_container, work_obj);
	// LOG_INF("Testing data originally: %s", container_ptr->testing_data);
	// container_ptr->testing_data = "New value";	
	// LOG_INF("Testing data changed to: %s", container_ptr->testing_data);
	// LOG_INF("Testing data after CONTAINER_OF method: %s", provisioning_container.testing_data);
	// LOG_INF("Provisioning work address that should be used: %x", provisioning_container.work_obj);
	// LOG_INF("Provisioning work address provided as argument: %x", item);
	// LOG_INF("Original struct address: %x", &provisioning_container);
	// LOG_INF("CONTAINER_OF struct address: %x", container_ptr);	

	LOG_INF("Send 'provisioning' request");
	coap_send_request(COAP_METHOD_GET,
			  (const struct sockaddr *)&multicast_local_addr,
			  provisioning_option, NULL, 0u, on_provisioning_reply);
}

static void toggle_minimal_sleepy_end_device(struct k_work *item)
{
	otError error;
	otLinkModeConfig mode;
	struct openthread_context *context = openthread_get_default_context();

	__ASSERT_NO_MSG(context != NULL);

	openthread_api_mutex_lock(context);
	mode = otThreadGetLinkMode(context->instance);
	mode.mRxOnWhenIdle = !mode.mRxOnWhenIdle;
	error = otThreadSetLinkMode(context->instance, mode);
	openthread_api_mutex_unlock(context);

	if (error != OT_ERROR_NONE) {
		LOG_ERR("Failed to set MLE link mode configuration");
	} else {
		on_mtd_mode_toggle(mode.mRxOnWhenIdle);
	}
}

static void update_device_state(void)
{
	struct otInstance *instance = openthread_get_default_instance();
	otLinkModeConfig mode = otThreadGetLinkMode(instance);
	on_mtd_mode_toggle(mode.mRxOnWhenIdle);
}

static void on_thread_state_changed(uint32_t flags, void *context)
{
	struct openthread_context *ot_context = context;

	if (flags & OT_CHANGED_THREAD_ROLE) {
		switch (otThreadGetDeviceRole(ot_context->instance)) {
		case OT_DEVICE_ROLE_CHILD:
		case OT_DEVICE_ROLE_ROUTER:
		case OT_DEVICE_ROLE_LEADER:
			k_work_submit(&on_connect_work);
			is_connected = true;
			break;

		case OT_DEVICE_ROLE_DISABLED:
		case OT_DEVICE_ROLE_DETACHED:
		default:
			k_work_submit(&on_disconnect_work);
			is_connected = false;
			break;
		}
	}
}

static void submit_work_if_connected(struct k_work *work)
{
	if (is_connected) {
		k_work_submit(work);
	} else {
		LOG_INF("Connection is broken");
	}
}

bool isProvisioned(){
	LOG_INF("Is provisioned, %s",unique_local_addr_str);
	return unique_local_addr_str[0];
}

void coap_client_utils_init(ot_connection_cb_t on_connect,
			    ot_disconnection_cb_t on_disconnect,
			    mtd_mode_toggle_cb_t on_toggle)
{
	on_mtd_mode_toggle = on_toggle;

	coap_init(AF_INET6, NULL);

	k_work_init(&on_connect_work, on_connect);
	k_work_init(&on_disconnect_work, on_disconnect);
	k_work_init(&sensor_data_container.work_obj, send_sensor_data);
	k_work_init(&provisioning_container.work_obj, send_provisioning_request);

	openthread_set_state_changed_cb(on_thread_state_changed);
	openthread_start(openthread_get_default_context());

	if (IS_ENABLED(CONFIG_OPENTHREAD_MTD_SED)) {
		k_work_init(&toggle_MTD_SED_work,
			    toggle_minimal_sleepy_end_device);
		update_device_state();
	}
}

void coap_client_send_sensor_data(uint16_t temperature_data, uint16_t humidity_data)
{
	sensor_data_container.humidity =  (float) humidity_data/10;
	sensor_data_container.temperature =  (float) temperature_data/10;

	LOG_INF("new value: %f", sensor_data_container.humidity);
	// sensor_data_container.humidity = 10.0;
	// sensor_data_container.temperature = 10.0;
	submit_work_if_connected(&sensor_data_container.work_obj);
}

void coap_client_send_provisioning_request(void)
{
	submit_work_if_connected(&provisioning_container.work_obj);
}

void coap_client_toggle_minimal_sleepy_end_device(void)
{
	if (IS_ENABLED(CONFIG_OPENTHREAD_MTD_SED)) {
		k_work_submit(&toggle_MTD_SED_work);
	}
}
```

## src/coap_client_utils.h
```c
/**
 * @file
 * @defgroup coap_client_utils API for coap_client_* samples
 * @{
 */

/*
 * Copyright (c) 2020 Nordic Semiconductor ASA
 *
 * SPDX-License-Identifier: LicenseRef-Nordic-5-Clause
 */

#ifndef __COAP_CLIENT_UTILS_H__
#define __COAP_CLIENT_UTILS_H__

/** @brief Struct for implementing k_work object as a member of a parent struct 
 * to enable passing of data to the function
 *
 *  
 */

struct work_var_container{
	struct k_work 	work_obj; 		/*Store the work object here*/
	char* 		testing_data;	/*Store the testing data here*/
};

struct work_sensor_container{
	struct k_work 	work_obj; 		/*Store the work object here*/
	float 			temperature;	/*Store the 'float' temperature data here*/
	float			humidity;		/*Store the 'float' humidity data here*/
};

/** @brief Type indicates function called when OpenThread connection
 *         is established.
 *
 * @param[in] item pointer to work item.
 */
typedef void (*ot_connection_cb_t)(struct k_work *item);

/** @brief Type indicates function called when OpenThread connection is ended.
 *
 * @param[in] item pointer to work item.
 */
typedef void (*ot_disconnection_cb_t)(struct k_work *item);

/** @brief Type indicates function called when the MTD modes are toggled.
 *
 * @param[in] val 1 if the MTD is in MED mode
 *                0 if the MTD is in SED mode
 */
typedef void (*mtd_mode_toggle_cb_t)(uint32_t val);

/** @brief Initialize CoAP client utilities.
 */
void coap_client_utils_init(ot_connection_cb_t on_connect,
			    ot_disconnection_cb_t on_disconnect,
			    mtd_mode_toggle_cb_t on_toggle);

/** @brief Toggle light on the CoAP server node.
 *
 * @note The CoAP server should be paired before to have an effect.
 */
void coap_client_send_sensor_data (uint16_t temperature_data, uint16_t humidity_data);


/** @brief Request for the CoAP server address to pair.
 *
 * @note Enable paring on the CoAP server to get the address.
 */
void coap_client_send_provisioning_request(void);

/** @brief Function to determine if successful provisioning was performed
 *  
 * @note Determined by checking byte-0 of IP address string, which is initialized to 0
 * After provisioning, the first byte is always set.
*/

bool isProvisioned(void);

/** @brief Toggle SED to MED and MED to SED modes.
 *
 * @note Active when the device is working as Minimal Thread Device.
 */
void coap_client_toggle_minimal_sleepy_end_device(void);

#endif

/**
 * @}
 */
```
